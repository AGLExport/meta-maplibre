## conf/layer.conf
```bitbake
# We have a conf and classes directory, add to BBPATH
BBPATH =. "${LAYERDIR}:"

# We have a packages directory, add to BBFILES
BBFILES += "${LAYERDIR}/recipes-*/*/*.bb \
            ${LAYERDIR}/recipes-*/*/*.bbappend"

BBFILE_COLLECTIONS += "meta-maplibre"
BBFILE_PATTERN_meta-maplibre = "^${LAYERDIR}/"
BBFILE_PRIORITY_meta-maplibre = "10"

LAYERVERSION_meta-maplibre = "1"

LAYERSERIES_COMPAT_meta-maplibre = "scarthgap"

LAYERDEPENDS_meta-maplibre = " \
    qt6-layer \
"
```
